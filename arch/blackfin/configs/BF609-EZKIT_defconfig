## drivers/staging/iio/meter/Kconfig
```kconfig
#
# IIO meter drivers configuration
#
comment "Active energy metering IC"

config ADE7754
	tristate "Analog Devices ADE7754 Polyphase Multifunction Energy Metering IC Driver"
	depends on SPI
	help
	  Say yes here to build support for Analog Devices ADE7754 Polyphase
	  Multifunction Energy Metering IC Driver.

config ADE7758
	tristate "Analog Devices ADE7758 Poly Phase Multifunction Energy Metering IC Driver"
	depends on SPI
	help
	  Say yes here to build support for Analog Devices ADE7758 Polyphase
	  Multifunction Energy Metering IC with Per Phase Information Driver.
```

## drivers/staging/iio/misc/Kconfig
```kconfig
#
# IIO misc drivers configuration
#
comment "Miscellaneous devices"

config ADIS16400
	tristate "Analog Devices ADIS16400/5 IMU SPI driver"
	depends on SPI
	help
	  Say yes here to build support for Analog Devices adis16400/5 triaxial
	  inertial sensor with Magnetometer.
```

## drivers/zaptel/Kconfig
```kconfig
#
# PBX driver configuration
#
#
menu "PBX support"

config PBX
	tristate "PBX support"
	select CRC_CCITT
	help
	  PBX is Private Branch eXchange. BF533 and BF537 STAMP board now
	  support PBX card which has 2 FXS ports, as well as 2 FXO ports.

config PBX_USE_SPI_FRAMEWORK
	bool "Use SPI framework"
	depends on PBX && SPI
	default y
	help
	  If you want to more than one SPI devices in your system, choose y. 

config J11_JUMPER
	int "FXS chip select PIN (J11) on PBX card"
	depends on PBX
	range 2 4 if (BF537 || BF536 || BF534)
	range 1 7
	default 3 if (BF537 || BF536 || BF534)
	default 5
	help
	  Input from 1-7, no confliction with others.

config J16_JUMPER
	int "Reset PIN (J16) on PBX card"
	depends on PBX
	range 2 4 if (BF537 || BF536 || BF534)
	range 1 7
	default 4
	help
	  Input from 1-7, no confliction with others.

config J19_JUMPER
	int "FSO chip select PIN (J19) on PBX card"
	depends on PBX
	range 2 4 if (BF537 || BF536 || BF534)
	range 1 7
	default 2 if (BF537 || BF536 || BF534)
	default 6
	help
	  Input form 1-7, no confliction with others.

endmenu # "PBX support"
```

## net/dsa/Kconfig
```kconfig
config HAVE_NET_DSA
	def_bool y
	depends on NETDEVICES && !S390

# Drivers must select NET_DSA and the appropriate tagging format

config NET_DSA
	tristate
	depends on HAVE_NET_DSA
	select PHYLIB

if NET_DSA

# tagging formats
config NET_DSA_TAG_DSA
	bool

config NET_DSA_TAG_EDSA
	bool

config NET_DSA_TAG_TRAILER
	bool

config NET_DSA_TAG_STPID
	bool
	default n

# switch drivers
config NET_DSA_MV88E6XXX
	bool
	default n

config NET_DSA_MV88E6060
	bool "Marvell 88E6060 ethernet switch chip support"
	select NET_DSA_TAG_TRAILER
	---help---
	  This enables support for the Marvell 88E6060 ethernet switch
	  chip.

config NET_DSA_MV88E6XXX_NEED_PPU
	bool
	default n

config NET_DSA_MV88E6131
	bool "Marvell 88E6085/6095/6095F/6131 ethernet switch chip support"
	select NET_DSA_MV88E6XXX
	select NET_DSA_MV88E6XXX_NEED_PPU
	select NET_DSA_TAG_DSA
	---help---
	  This enables support for the Marvell 88E6085/6095/6095F/6131
	  ethernet switch chips.

config NET_DSA_MV88E6123_61_65
	bool "Marvell 88E6123/6161/6165 ethernet switch chip support"
	select NET_DSA_MV88E6XXX
	select NET_DSA_TAG_EDSA
	---help---
	  This enables support for the Marvell 88E6123/6161/6165
	  ethernet switch chips.

config NET_DSA_KSZ8893M
	bool "MICREL KSZ8893MQL/BL ethernet switch chip support"
	depends on SPI
	select NET_DSA_TAG_STPID
	---help---
	  This enables support for the Micrel KSZ8893MQL/BL
	  ethernet switch chips.

endif
```

## sound/blackfin/Kconfig
```kconfig
#
menu "ALSA Blackfin devices"
	depends on SND && BLACKFIN

config SND_BFIN_SPORT
	int "Blackfin Audio SPORT port"
	depends on SND_BFIN_AD73311
	default 0
	help
	  Enter the Blackfin SPORT port to which your sound chip is connected
	  acceptable values are 0 or 1

config SND_BFIN_AD73322
	tristate "Cascaded AD73322 Audio support for BF53x"
	depends on SND && BLACKFIN
	select SND_PCM
	help
	  Select this if you have AD73322 connected in cascade mode connected to SPORT0 ports

	  To compile this driver as a module, choose M here: the
	  module will be called snd-ad73322.

	  If unsure, say N.

config SND_BFIN_SPORT
	int "Blackfin Audio SPORT port"
	depends on SND_BFIN_AD73322
	default 2
	help
	  Enter the Blackfin SPORT port to which your sound chip is connected
	  acceptable values are 0 ,1 or 2.Input 0 or 1 if, you have one card on SPORT0 or SPORT1,
	  Input 2 if you have two card on SPORT0 and SPORT1. 	

config SND_BFIN_AD73322_SPORT0_SE
	int "PF pin for AD73322 Chip Select on SPORT0"
	depends on SND_BFIN_AD73322
	default 10
	help
	  Enter the GPIO used to control AD73322's SE pin. Acceptable
	  values are 0 to 10

config SND_BFIN_AD73322_SPORT1_SE
	int "PF pin for AD73322 Chip Select on SPORT1"
	depends on SND_BFIN_AD73322
	default 14
	help
	  Enter the GPIO used to control AD73322's SE pin. Acceptable
	  values are 11 to 14

config SND_BFIN_AD73322_RESET
	int "PF pin for AD73322 Chip Reset"
	depends on SND_BFIN_AD73322
	default 12
	help
	  Enter the GPIO used to control AD73322's RESET pin. Acceptable
	  values are 0 to 14

endmenu
```

## sound/soc/blackfin/Kconfig
```kconfig
config SND_BF5XX_SOC
	tristate "SoC Audio for the ADI BF5xx chip"
	depends on BLACKFIN && SND_SOC
	help
	  Say Y or M if you want to add support for codecs attached to
	  the BF5xx AC97 interface.  You will also need
	  to select the audio interfaces to support below.

config SND_MMAP_SUPPORT
	bool "Enable MMAP Support"
	depends on SND_BF5XX_SOC
	default y
	help
	  Say y if you want driver to support mmap way.

config SND_BF5XX_AC97
	tristate
	select SND_AC97_CODEC
	
config SND_BF5XX_SOC_I2S
	tristate

config SND_BF5XX_SOC_AC97
	tristate
	select AC97_BUS
	select SND_SOC_AC97_BUS

config SND_BF5XX_SOC_BF548_EZKIT
	tristate "SoC AC97 Audio support for BF548 ezkit"
	depends on SND_BF5XX_SOC && BFIN548_EZKIT && !BF542 && !BF544
	select SND_BF5XX_SOC_AC97
	select SND_SOC_AD1980
	help
	  Say Y if you want to add support for SoC audio on BF548-EZKIT.

config SND_BF5XX_SOC_WM8750
	tristate "SoC WM8750 Audio support for BF5xx ezkit"
	depends on SND_BF5XX_SOC
	select SND_BF5XX_SOC_I2S
	select SND_SOC_WM8750
	help
	  Say Y if you want to add support for SoC audio on BF548-EZKIT.

config SND_BF5XX_SOC_WM8731
	tristate "SoC WM8731 Audio support for BF5xx ezkit"
	depends on SND_BF5XX_SOC
	select SND_BF5XX_SOC_I2S
	select SND_SOC_WM8731
	help
	  Say Y if you want to add support for SoC audio on BF527-EZKIT.

config SND_BF5XX_SOC_SSM2602
	tristate "SoC SSM2602 Audio support for BF52x ezkit"
	depends on SND_BF5XX_SOC
	select SND_BF5XX_SOC_I2S
	select SND_SOC_SSM2602
	select I2C
	select I2C_BLACKFIN_TWI
	help
	  Say Y if you want to add support for SoC audio on BF527-EZKIT.


config SND_BF5XX_SOC_BF5xx
	tristate "SoC AC97 Audio support for BF5xx"
	depends on SND_BF5XX_SOC && !BFIN548_EZKIT
	select SND_BF5XX_SOC_AC97
	select SND_SOC_AD1980
	help
	  Say Y if you want to add support for SoC audio on BF5xx STAMP/EZKIT.

config SND_BF5XX_SPORT_NUM
	int "Set a SPORT for Sound chip"
	depends on SND_BF5XX_SOC
	range 0 3 if BF54x
	range 0 1 if (BF53x || BF561)
	default 0
	help
	  Set the correct SPORT for sound chip.

config SND_BF5XX_HAVE_COLD_RESET
	bool "BOARD has COLD Reset GPIO"
	depends on SND_BF5XX_SOC
	default y if BFIN548_EZKIT
	default n if !BFIN548_EZKIT
	
config SND_BF5XX_RESET_GPIO_NUM
	int "Set a GPIO for cold reset"
	depends on SND_BF5XX_HAVE_COLD_RESET
	range 0 159
	default 19 if BFIN548_EZKIT
	default 5 if BFIN537_STAMP
	help
	  Set the correct GPIO for RESET the sound chip.
```

## sound/soc/codecs/Kconfig
```kconfig
config SND_SOC_AC97_CODEC
	tristate
	depends on SND_SOC

config SND_SOC_WM8731
	tristate
	depends on SND_SOC

config SND_SOC_WM8750
	tristate
	depends on SND_SOC

config SND_SOC_WM8753
	tristate
	depends on SND_SOC

config SND_SOC_WM9712
	tristate
	depends on SND_SOC

config SND_SOC_WM8960
	tristate
	depends on SND_SOC

config SND_SOC_AD1980
	tristate
	depends on SND_SOC
	
config SND_SOC_WM8731_SPI
	bool "Control interface: Use SPI instead of I2C"
	depends on SND_SOC_WM8731
	default n
```
