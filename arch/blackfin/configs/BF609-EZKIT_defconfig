## arch/blackfin/configs/BF609-EZKIT_defconfig
```kconfig
CONFIG_EXPERIMENTAL=y
CONFIG_SYSVIPC=y
CONFIG_IKCONFIG=y
CONFIG_IKCONFIG_PROC=y
CONFIG_LOG_BUF_SHIFT=14
# CONFIG_CC_OPTIMIZE_FOR_SIZE is not set
CONFIG_EXPERT=y
# CONFIG_SYSCTL_SYSCALL is not set
# CONFIG_ELF_CORE is not set
# CONFIG_FUTEX is not set
# CONFIG_SIGNALFD is not set
# CONFIG_TIMERFD is not set
# CONFIG_EVENTFD is not set
# CONFIG_AIO is not set
CONFIG_SLAB=y
CONFIG_MMAP_ALLOW_UNINITIALIZED=y
CONFIG_MODULES=y
CONFIG_MODULE_UNLOAD=y
# CONFIG_LBDAF is not set
# CONFIG_BLK_DEV_BSG is not set
# CONFIG_IOSCHED_DEADLINE is not set
# CONFIG_IOSCHED_CFQ is not set
CONFIG_PREEMPT_VOLUNTARY=y
CONFIG_BF609=y
CONFIG_BF609_FPGA=y
CONFIG_IRQ_TIMER0=11
CONFIG_PINT1_ASSIGN=0x01010000
CONFIG_PINT2_ASSIGN=0x07000101
CONFIG_PINT3_ASSIGN=0x02020303
CONFIG_CMDLINE_BOOL=y
CONFIG_CMDLINE="earlyprintk=serial,uart0,57600 console=ttyBF0,57600"
CONFIG_BOOT_LOAD=0xB4001000
CONFIG_CLKIN_HZ=50000000
# CONFIG_I_ENTRY_L1 is not set
# CONFIG_EXCPT_IRQ_SYSC_L1 is not set
# CONFIG_DO_IRQ_L1 is not set
# CONFIG_CORE_TIMER_IRQ_L1 is not set
# CONFIG_IDLE_L1 is not set
# CONFIG_SCHEDULE_L1 is not set
# CONFIG_ARITHMETIC_OPS_L1 is not set
# CONFIG_ACCESS_OK_L1 is not set
# CONFIG_MEMSET_L1 is not set
# CONFIG_MEMCPY_L1 is not set
# CONFIG_STRCMP_L1 is not set
# CONFIG_STRNCMP_L1 is not set
# CONFIG_STRCPY_L1 is not set
# CONFIG_STRNCPY_L1 is not set
# CONFIG_SYS_BFIN_SPINLOCK_L1 is not set
# CONFIG_CACHELINE_ALIGNED_L1 is not set
# CONFIG_ICACHE_FLUSH_L1 is not set
# CONFIG_DCACHE_FLUSH_L1 is not set
# CONFIG_APP_STACK_L1 is not set
# CONFIG_BFIN_INS_LOWOVERHEAD is not set
CONFIG_NOMMU_INITIAL_TRIM_EXCESS=0
CONFIG_DMA_UNCACHED_NONE=y
# CONFIG_BFIN_ICACHE is not set
# CONFIG_BFIN_DCACHE is not set
CONFIG_BANK_3=0x99B2
CONFIG_BINFMT_FLAT=y
CONFIG_BINFMT_ZFLAT=y
# CONFIG_SUSPEND is not set
CONFIG_UEVENT_HELPER_PATH="/sbin/hotplug"
CONFIG_FW_LOADER=m
CONFIG_BLK_DEV_RAM=y
# CONFIG_INPUT_MOUSEDEV is not set
# CONFIG_INPUT_KEYBOARD is not set
# CONFIG_INPUT_MOUSE is not set
# CONFIG_SERIO is not set
# CONFIG_LEGACY_PTYS is not set
# CONFIG_BFIN_DMA_INTERFACE is not set
# CONFIG_DEVKMEM is not set
CONFIG_SERIAL_BFIN=y
CONFIG_SERIAL_BFIN_CONSOLE=y
CONFIG_SERIAL_BFIN_UART0=y
# CONFIG_HW_RANDOM is not set
CONFIG_GPIOLIB=y
CONFIG_GPIO_SYSFS=y
# CONFIG_HWMON is not set
# CONFIG_MFD_SUPPORT is not set
# CONFIG_HID_SUPPORT is not set
# CONFIG_USB_SUPPORT is not set
# CONFIG_DNOTIFY is not set
# CONFIG_MISC_FILESYSTEMS is not set
CONFIG_DEBUG_FS=y
CONFIG_DEBUG_KERNEL=y
CONFIG_DEBUG_SHIRQ=y
CONFIG_DETECT_HUNG_TASK=y
CONFIG_DEBUG_INFO=y
CONFIG_FRAME_POINTER=y
# CONFIG_FTRACE is not set
CONFIG_DEBUG_BFIN_HWTRACE_COMPRESSION_ONE=y
CONFIG_EARLY_PRINTK=y
CONFIG_BFIN_PSEUDODBG_INSNS=y
CONFIG_CRYPTO=y
CONFIG_CRYPTO_HMAC=y
CONFIG_CRYPTO_MD4=y
CONFIG_CRYPTO_MD5=y
CONFIG_CRYPTO_ARC4=y
# CONFIG_CRYPTO_ANSI_CPRNG is not set
CONFIG_CRC_CCITT=m
```

## arch/blackfin/mach-bf609/Kconfig
```kconfig
config BF60x
	def_bool y
	depends on (BF609)

if (BF60x)

source "arch/blackfin/mach-bf609/boards/Kconfig"

menu "BF609 Specific Configuration"

comment "Interrupt Priority Assignment"
menu "Priority"

config IRQ_EPPI0
	int "IRQ_EPPI0"
	default 8
config IRQ_SPORT0_RX
	int "IRQ_SPORT0_RX"
	default 9
config IRQ_SPORT0_TX
	int "IRQ_SPORT0_TX"
	default 9
config IRQ_SPORT1_RX
	int "IRQ_SPORT1_RX"
	default 9
config IRQ_SPORT1_TX
	int "IRQ_SPORT1_TX"
	default 9
config IRQ_SPI0
	int "IRQ_SPI0"
	default 10
config IRQ_UART0_RX
	int "IRQ_UART0_RX"
	default 10
config IRQ_UART0_TX
	int "IRQ_UART0_TX"
	default 10
config IRQ_PINT0
	int "IRQ_PINT0"
	default 12
config IRQ_PINT1
	int "IRQ_PINT0"
	default 12
config IRQ_MDMAS0
	int "IRQ_MDMAS0"
	default 13
config IRQ_MDMAS1
	int "IRQ_DMDMAS1"
	default 13
config IRQ_WATCHDOG
	int "IRQ_WATCHDOG"
	default 13
config IRQ_SPI1_ERR
	int "IRQ_SPI1_ERR"
	default 7
config IRQ_SPORT2_RX
	int "IRQ_SPORT2_RX"
	default 9
config IRQ_SPORT2_TX
	int "IRQ_SPORT2_TX"
	default 9
config IRQ_EPPI1
	int "IRQ_EPPI1"
	default 9
config IRQ_EPPI2
	int "IRQ_EPPI2"
	default 9
config IRQ_SPI1
	int "IRQ_SPI1"
	default 10
config IRQ_UART1_RX
	int "IRQ_UART1_RX"
	default 10
config IRQ_UART1_TX
	int "IRQ_UART1_TX"
	default 10
config IRQ_TWI0
	int "IRQ_TWI0"
	default 11
config IRQ_TWI1
	int "IRQ_TWI1"
	default 11
config IRQ_CAN0_RX
	int "IRQ_CAN_RX"
	default 11
config IRQ_CAN0_TX
	int "IRQ_CAN_TX"
	default 11
config IRQ_MDMAS2
	int "IRQ_MDMAS2"
	default 13
config IRQ_MDMAS3
	int "IRQ_DMMAS3"
	default 13
config IRQ_PIXC_CH0
	int "IRQ PIXC CH0"
	default 8
config IRQ_PIXC_CH1
	int "IRQ PIXC CH1"
	default 8
config IRQ_PIXC_CH2
	int "IRQ PIXC CH2"
	default 8
config IRQ_RSI
	int "IRQ RSI"
	default 8
config IRQ_USB_INT0
	int "IRQ USB INT0"
	default 11
config IRQ_USB_DMA
	int "IRQ USB DMA"
	default 11
config IRQ_TIMER0
	int "IRQ_TIMER0"
	default 7 if TICKSOURCE_GPTMR0
	default 8
config IRQ_TIMER1
	int "IRQ_TIMER1"
	default 11
config IRQ_TIMER2
	int "IRQ_TIMER2"
	default 11
config IRQ_TIMER3
	int "IRQ_TIMER3"
	default 11
config IRQ_TIMER4
	int "IRQ_TIMER4"
	default 11
config IRQ_TIMER5
	int "IRQ_TIMER5"
	default 11
config IRQ_TIMER6
	int "IRQ_TIMER6"
	default 11
config IRQ_TIMER7
	int "IRQ_TIMER7"
	default 11
config IRQ_PINT2
	int "IRQ_PIN2"
	default 11
config IRQ_PINT3
	int "IRQ_PIN3"
	default 11
config IRQ_PINT4
	int "IRQ_PIN4"
	default 11
config IRQ_PINT5
	int "IRQ_PIN5"
	default 11

	help
	  Enter the priority numbers between 0-255.  Others are invalid.

endmenu

comment "Pin Interrupt to Port Assignment"
menu "Assignment"

config PINTx_REASSIGN
	bool "Reprogram PINT Assignment"
	default y
	help
	  The interrupt assignment registers controls the pin-to-interrupt
	  assignment in a byte-wide manner. Each option allows you to select
	  a set of pins (High/Low Byte) of an specific Port being mapped
	  to one of the four PIN Interrupts IRQ_PINTx.

	  You shouldn't change any of these unless you know exactly what you're doing.
	  Please consult the Blackfin BF60x Processor Hardware Reference Manual.

config PINT0_ASSIGN
	hex "PINT0_ASSIGN"
	depends on PINTx_REASSIGN
	default 0x00000101
config PINT1_ASSIGN
	hex "PINT1_ASSIGN"
	depends on PINTx_REASSIGN
	default 0x00000101
config PINT2_ASSIGN
	hex "PINT2_ASSIGN"
	depends on PINTx_REASSIGN
	default 0x00000101
config PINT3_ASSIGN
	hex "PINT3_ASSIGN"
	depends on PINTx_REASSIGN
	default 0x00000101
config PINT4_ASSIGN
	hex "PINT3_ASSIGN"
	depends on PINTx_REASSIGN
	default 0x00000101
config PINT5_ASSIGN
	hex "PINT3_ASSIGN"
	depends on PINTx_REASSIGN
	default 0x00000101

endmenu

endmenu

endif
```

## drivers/media/video/blackfin/Kconfig
```kconfig
config VIDEO_BLACKFIN_CAPTURE
	tristate "Blackfin Video Capture Driver"
	depends on VIDEO_V4L2 && BLACKFIN && I2C
	select VIDEOBUF2_DMA_CONTIG
	help
	  V4L2 bridge driver for Blackfin video capture device.
	  Choose PPI or EPPI as its interface.

	  To compile this driver as a module, choose M here: the
	  module will be called bfin_video_capture.

config VIDEO_BLACKFIN_DISPLAY
	tristate "Blackfin Video Display Driver"
	depends on VIDEO_V4L2 && BLACKFIN && I2C
	select VIDEOBUF2_DMA_CONTIG
	help
	  V4L2 bridge driver for Blackfin video display device.
	  Choose PPI or EPPI as its interface.

	  To compile this driver as a module, choose M here: the
	  module will be called bfin_video_display.
```

## drivers/mmc/spi_mmc/Kconfig
```kconfig
#
# SPI_MMC subsystem configuration
#

config SPI_MMC
	tristate "MMC/SD for SPI support (EXPERIMENTAL)"
	depends on EXPERIMENTAL
	default n
	help
	  MMC/SD card over SPI support.
	
	  Say Y or M here if you want to attach an MMC/SD socket to the SPI port.
	  The "MMC support" option does not need to be enabled for this driver to work.

	  Note, deselct SPI framework driver and any drivers depending on it to make this
	  driver use the blackfin SPI bus directly in PIO mode.

	  Read spi_mmc.txt documentation for details or more help.

choice
	prompt "SPI driver"
	depends on SPI_MMC

config SPI_MMC_FRAMEWORK_DRIVER
	bool "SPI framework master"
	depends on SPI
	help
	  Will use the SPI master of the system. This option is platform indepenent.

config SPI_MMC_BFIN_PIO_SPI
	bool "Blackfin SPI bus directly"
	depends on BFIN
	help
	  Will use Blackfin SPI bus directly. No other SPI device should be used with this option.
	  The MMC/SD card will be driven in SPI PIO mode. This is a failsafe option for testing.

	  Enable SPI framework to use the SPI master instead.

	  NOTE! Using this when SPI framework driver is enabled is not recommended.
endchoice


config SPI_MMC_CS_CHAN
	int "SPI chip select signal for MMC/SD card"
	depends on SPI_MMC
	range 0 16
	default "4"
	help
	  Set the Chip Select signal to use for the MMC/SD card. This number is one of the
	  SPI master controller SPISEL signals.

config SPI_MMC_MAX_HZ
	int "SPI clock limit for MMC/SD transfers"
	depends on SPI_MMC
	range 400000 30000000
	default "20000000"
	help
	  Maximum clock to aim for when configuring the underlaying SPI device. It may
	  not be possible to set it exactly to this value since the actual clock could
	  depend on an integer division from a reference. Cards seldom support higher
	  clocks than 20Mhz over the SPI bus.

config SPI_MMC_CARD_DETECT
	bool "MMC/SD Card detect support (EXPERIMENTAL)"
	depends on SPI_MMC && BFIN
	default "n"
	help
	  MMC/SD card insertion can be detected with a dedicated signal. Configure the IRQ#
	  that is triggered by this signal on falling edge.

config SPI_MMC_CARD_DETECT_INT
	int "IRQ# for card detection"
	depends on SPI_MMC_CARD_DETECT
	default "5"
	help
	  Which IRQ number to use for card detection.

config SPI_MMC_DEBUG_MODE
	bool "Print debug text on errors"
	depends on SPI_MMC && !SPI_MMC_CARD_DETECT
	default n
	help
	  Will print verobse debug data during MMC/SD errors of any kind. Note that
	  during card initialization errors are normal.
```

## drivers/staging/icc/Kconfig
```kconfig
#
# intercore communication protocol and impelementation on bf561
#

menuconfig ICC_DRIVER
	bool "icc driver"
	select BF561_COREB
	help
	  the icc driver is a device driver that control the DSP devices,
	  and bridges the the program runing on DSPs and linux user applications
if ICC_DRIVER
config	ICC
	bool "icc protocol"
	default N
	help
	  ICC protocol, a shared memory based protocol for communication between
	  linux core and DSP core
endif
```

## drivers/staging/iio/adc/Kconfig
```kconfig
#
# ADC drivers
#
comment "Analog to digital convertors"

config MAX1363
	tristate "MAXIM max1363 ADC driver"
	depends on I2C
	select IIO_TRIGGER if IIO_RING_BUFFER
	select MAX1363_RING_BUFFER
	help
	  Say yes here to build support for many MAXIM i2c analog to digital
	  convertors (ADC). (max1361, max1362, max1363, max1364, max1036,
	  max1037, max1038, max1039, max1136, max1136, max1137, max1138,
	  max1139, max1236, max1237, max11238, max1239, max11600, max11601,
	  max11602, max11603, max11604, max11605, max11606, max11607,
	  max11608, max11609, max11610, max11611, max11612, max11613,
	  max11614, max11615, max11616, max11617) Provides direct access
	  via sysfs.

config MAX1363_RING_BUFFER
	bool "MAXIM max1363: use ring buffer"
	depends on MAX1363
	select IIO_RING_BUFFER
	select IIO_SW_RING
	help
	  Say yes here to include ring buffer support in the MAX1363
	  ADC driver.

config AD7150
	tristate "Analog Devices ad7150/1/6 capacitive sensor driver"
	depends on I2C
	help
	  Say yes here to build support for Analog Devices capacitive sensors.
	  (ad7150, ad7151, ad7156) Provides direct access via sysfs.

config AD7152
	tristate "Analog Devices ad7152/3 capacitive sensor driver"
	depends on I2C
	help
	  Say yes here to build support for Analog Devices capacitive sensors.
	  (ad7152, ad7153) Provides direct access via sysfs.

config AD7291
	tristate "Analog Devices AD7291 temperature sensor driver"
	depends on I2C
	help
	  Say yes here to build support for Analog Devices AD7291
	  temperature sensors.

config AD7298
	tristate "Analog Devices AD7298 temperature sensor and ADC driver"
	depends on SPI
	help
	  Say yes here to build support for Analog Devices AD7298
	  temperature sensors and ADC.

config AD7314
	tristate "Analog Devices AD7314 temperature sensor driver"
	depends on SPI
	help
	  Say yes here to build support for Analog Devices AD7314
	  temperature sensors.

config AD7414
	tristate "Analog Devices AD7414 and AD7415 temperature sensor driver"
	depends on I2C
	help
	  Say yes here to build support for Analog Devices AD7414 and AD7415
	  temperature sensors.

config AD7416
	tristate "Analog Devices AD7416/7/8 temperature sensor and ADC driver"
	depends on I2C
	help
	  Say yes here to build support for Analog Devices AD74167/8
	  temperature sensors and ADC.

config AD7476
	tristate "Analog Devices AD7475/6/7/8 and AD7495 ADC driver"
	depends on SPI
	help
	  Say yes here to build support for Analog Devices AD7475/6/7/8,
	  AD7495 ADC driver.
	  If unsure, say N (but it's safe to say "Y").

	  To compile this driver as a module, choose M here: the
	  module will be called ad7476.

config AD774X
	tristate "Analog Devices ad7745/6/7 capacitive sensor driver"
	depends on I2C
	help
	  Say yes here to build support for Analog Devices capacitive sensors.
	  (ad7745, ad7746, ad7747) Provides direct access via sysfs.

config AD7816
	tristate "Analog Devices AD7816/7/8 temperature sensor and ADC driver"
	depends on SPI
	help
	  Say yes here to build support for Analog Devices AD7816/7/8
	  temperature sensors and ADC.

config AD799X
	tristate "Analog Devices AD799x ADC driver"
	depends on I2C
	select IIO_TRIGGER if IIO_RING_BUFFER
	select AD799X_RING_BUFFER
	help
	  Say yes here to build support for Analog Devices:
	  ad7991, ad7995, ad7999, ad7992, ad7993, ad7994, ad7997, ad7998
	  i2c analog to digital convertors (ADC). Provides direct access
	  via sysfs.

config AD799X_RING_BUFFER
	bool "Analog Devices AD799x: use ring buffer"
	depends on AD799X
	select IIO_RING_BUFFER
	select IIO_SW_RING
	help
	  Say yes here to include ring buffer support in the AD799X
	  ADC driver.

config ADT75
	tristate "Analog Devices ADT75 temperature sensor driver"
	depends on I2C
	help
	  Say yes here to build support for Analog Devices ADT75
	  temperature sensors.

config ADT7408
	tristate "Analog Devices ADT7408 temperature sensor driver"
	depends on I2C
	help
	  Say yes here to build support for Analog Devices ADT7408
	  temperature sensors.

config ADT7410
	tristate "Analog Devices ADT7410 temperature sensor driver"
	depends on I2C
	help
	  Say yes here to build support for Analog Devices ADT7410
	  temperature sensors.

config ADT7310
	tristate "Analog Devices ADT7310 temperature sensor driver"
	depends on SPI
	help
	  Say yes here to build support for Analog Devices ADT7310
	  temperature sensors.
```

## drivers/staging/iio/addac/Kconfig
```kconfig
#
# ADDAC drivers
#
comment "Analog digital bi-direction convertors"

config ADT7316
	tristate "Analog Devices ADT7316/7/8 ADT7516/7/9 temperature sensor, ADC and DAC driver"
	depends on SPI
	help
	  Say yes here to build support for Analog Devices ADT7316/7/8
	  and ADT7516/7/9 temperature sensors, ADC and DAC.

config ADT7316_SPI
	tristate "Analog Devices ADT7316/7/8 ADT7516/7/9 SPI bus driver"
	depends on SPI && ADT7316
	default y
	help
	  Say yes here to build SPI bus support for Analog Devices ADT7316/7/8
	  and ADT7516/7/9.

config ADT7316_I2C
	tristate "Analog Devices ADT7316/7/8 ADT7516/7/9 I2C bus driver"
	depends on I2C && ADT7316
	help
	  Say yes here to build I2C bus support for Analog Devices ADT7316/7/8
	  and ADT7516/7/9.
```

## drivers/staging/iio/gyro/Kconfig
```kconfig
#
# IIO Digital Gyroscope Sensor drivers configuration
#
comment "Digital gyroscope sensors"

config ADIS16260
	tristate "Analog Devices ADIS16260/5 Digital Gyroscope Sensor SPI driver"
	depends on SPI
	help
	  Say yes here to build support for Analog Devices adis16260/5 programmable
	  digital gyroscope sensor.
```
